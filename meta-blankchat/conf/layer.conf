## meta-blankchat/conf/layer.conf
```bitbake
BBPATH .= ":${LAYERDIR}"

# We have recipes-* directories, add to BBFILES
BBFILES += "${LAYERDIR}/recipes-*/*/*.bb \
            ${LAYERDIR}/recipes-*/*/*.bbappend"

BBFILE_COLLECTIONS += "meta-blankchat"
BBFILE_PATTERN_meta-blankchat = "^${LAYERDIR}/"
BBFILE_PRIORITY_meta-blankchat = "6"

LAYERDEPENDS_meta-blankchat = "core"
LAYERSERIES_COMPAT_meta-blankchat = "scarthgap"

INHERIT:remove = "uninative"
```
