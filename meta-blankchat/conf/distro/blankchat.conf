## meta-blankchat/conf/distro/blankchat.conf
```bitbake
require conf/distro/poky.conf

DISTRO = "blankchat"
DISTRO_NAME = "Blank Chat Custom OS"
DISTRO_VERSION = "1.0"

DISTRO_FEATURES:remove = "x11 wayland alsa pulseaudio bluetooth 3g nfc opengl ptest pcmcia"
DISTRO_FEATURES:append = " ipv4 ipv6 wifi systemd seccomp usrmerge security"

VIRTUAL-RUNTIME_init_manager = "systemd"
DISTRO_FEATURES_BACKFILL_CONSIDERED = "sysvinit"

require conf/distro/include/security_flags.inc
```

## meta-blankchat/recipes-core/images/blankchat-client.wks
```
part /boot --source bootimg-efi --sourceparams="loader=grub-efi" --ondisk sda --label boot --active --align 1024 --use-uuid

part / --source rootfs --ondisk sda --fstype=ext4 --label root --align 1024 --use-uuid

bootloader --ptable gpt --timeout=2 --append="console=ttyS0,115200 console=tty0"
```
